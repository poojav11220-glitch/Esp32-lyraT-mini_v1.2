#include <stdio.h>
#include <string.h>
#include "freertos/FreeRTOS.h"
#include "freertos/task.h"
#include "driver/gpio.h"
#include "rom/ets_sys.h"

/* ── Pin config (JTAG header: TCLK=SDA, TMS=SCL) ── */
#define SDA_PIN         13
#define SCL_PIN         14
#define OLED_ADDR       0x3C
#define OLED_CMD_MODE   0x00
#define OLED_DATA_MODE  0x40

/* ── Bit-bang I2C — 5 µs half-period ≈ 100 kHz ── */
#define I2C_DELAY()  ets_delay_us(5)

static inline void sda_hi(void) { gpio_set_level(SDA_PIN, 1); }
static inline void sda_lo(void) { gpio_set_level(SDA_PIN, 0); }
static inline void scl_hi(void) { gpio_set_level(SCL_PIN, 1); }
static inline void scl_lo(void) { gpio_set_level(SCL_PIN, 0); }

static void i2c_start(void)
{
    sda_hi(); I2C_DELAY();
    scl_hi(); I2C_DELAY();
    sda_lo(); I2C_DELAY();
    scl_lo(); I2C_DELAY();
}

static void i2c_stop(void)
{
    sda_lo(); I2C_DELAY();
    scl_hi(); I2C_DELAY();
    sda_hi(); I2C_DELAY();
}

static void i2c_write_byte(uint8_t byte)
{
    for (int i = 7; i >= 0; i--) {
        if ((byte >> i) & 1) sda_hi(); else sda_lo();
        I2C_DELAY();
        scl_hi(); I2C_DELAY();
        scl_lo(); I2C_DELAY();
    }
    sda_hi(); I2C_DELAY();   // release SDA for ACK
    scl_hi(); I2C_DELAY();   // clock ACK bit
    scl_lo(); I2C_DELAY();
}

static void soft_i2c_init(void)
{
    gpio_config_t cfg = {
        .pin_bit_mask    = (1ULL << SDA_PIN) | (1ULL << SCL_PIN),
        .mode            = GPIO_MODE_OUTPUT_OD,   // open-drain
        .pull_up_en      = GPIO_PULLUP_ENABLE,
        .pull_down_en    = GPIO_PULLDOWN_DISABLE,
        .intr_type       = GPIO_INTR_DISABLE,
    };
    gpio_config(&cfg);
    sda_hi();
    scl_hi();
    ets_delay_us(100);
}

/* ── OLED helpers ── */
static void oled_send_cmd(uint8_t cmd)
{
    i2c_start();
    i2c_write_byte((OLED_ADDR << 1) | 0);
    i2c_write_byte(OLED_CMD_MODE);
    i2c_write_byte(cmd);
    i2c_stop();
}

static void oled_send_data(const uint8_t *data, size_t len)
{
    i2c_start();
    i2c_write_byte((OLED_ADDR << 1) | 0);
    i2c_write_byte(OLED_DATA_MODE);
    for (size_t i = 0; i < len; i++)
        i2c_write_byte(data[i]);
    i2c_stop();
}

/* ── SH1106 init (GME12864-11 controller) ── */
static void oled_init(void)
{
    const uint8_t cmds[] = {
        0xAE,       // display off
        0xD5,0x80,  // clock divide ratio
        0xA8,0x3F,  // multiplex 64
        0xD3,0x00,  // display offset 0
        0x40,       // display start line 0
        0xAD,0x8B,  // charge pump on (SH1106)
        0xA1,       // segment remap
        0xC8,       // COM scan direction
        0xDA,0x12,  // COM pins
        0x81,0xCF,  // contrast
        0xD9,0x1F,  // pre-charge
        0xDB,0x40,  // VCOMH
        0xA4,       // resume from RAM
        0xA6,       // normal display
        0xAF,       // display ON
    };
    for (size_t i = 0; i < sizeof(cmds); i++)
        oled_send_cmd(cmds[i]);
}

/* ── Clear screen ── */
static void oled_clear(void)
{
    uint8_t blank[128] = {0};
    for (int page = 0; page < 8; page++) {
        oled_send_cmd(0xB0 + page);
        oled_send_cmd(0x02);   // column low  (SH1106 offset=2)
        oled_send_cmd(0x10);   // column high
        oled_send_data(blank, 128);
    }
}

/* ── Set cursor ── */
static void oled_set_cursor(uint8_t page, uint8_t col)
{
    col += 2;   // SH1106: visible RAM starts at column 2
    oled_send_cmd(0xB0 + page);
    oled_send_cmd(0x00 + (col & 0x0F));
    oled_send_cmd(0x10 + (col >> 4));
}

/* ── 5x7 font (ASCII 32–122) ── */
static const uint8_t font5x7[][5] = {
    {0x00,0x00,0x00,0x00,0x00}, // ' '
    {0x00,0x00,0x5F,0x00,0x00}, // '!'
    {0x00,0x07,0x00,0x07,0x00}, // '"'
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    {0x44,0x64,0x54,0x4C,0x44}, // 'z'
};

static void oled_draw_char(uint8_t page, uint8_t col, char c)
{
    if (c < 32 || c > 122) c = ' ';
    oled_set_cursor(page, col);
    uint8_t glyph[6];
    memcpy(glyph, font5x7[c - 32], 5);
    glyph[5] = 0x00;
    oled_send_data(glyph, 6);
}

static void oled_draw_string(uint8_t page, uint8_t col, const char *str)
{
    while (*str) {
        oled_draw_char(page, col, *str++);
        col += 6;
        if (col > 122) break;
    }
}

/* ── Main ── */
void app_main(void)
{
    soft_i2c_init();
    vTaskDelay(pdMS_TO_TICKS(100));   // let OLED power rail settle

    oled_init();
    oled_clear();

    oled_draw_string(0, 0, "Hello World!");
    oled_draw_string(2, 0, "ESP32 LyraT");
    oled_draw_string(3, 0, "Counter:");

    int counter = 0;
    char buf[20];

    while (1) {
        snprintf(buf, sizeof(buf), "%d   ", counter);
        oled_draw_string(4, 0, buf);
        printf("Counter: %d\n", counter);
        counter++;
        vTaskDelay(pdMS_TO_TICKS(1000));
    }
}
